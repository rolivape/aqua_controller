## esp32_firmware/components/usb_comm_aq/Kconfig
```kconfig
menu "Aqua Controller USB Configuration"

    config AQ_USB_MAC_AUTOGEN
        bool "Autogenerate USB MAC Address"
        default y
        help
            If enabled, a unique MAC address for the USB network interface will be
            generated from the device's eFuse MAC and stored in NVS on the first
            boot. If disabled, a fallback MAC address must be provided.

endmenu
```

## esp32_firmware/sdkconfig.defaults
```kconfig
CONFIG_TINYUSB_NCM_IN_NTB_BUFF_MAX_SIZE=4096
CONFIG_TINYUSB_NCM_OUT_NTB_BUFF_MAX_SIZE=4096
CONFIG_TINYUSB_DESC_BUF_SIZE=512
```
